## drivers/power/supply/Kconfig.garnet
```kconfig
# QTI charger and Xiaomi BQ fuel gauge symbols for garnet.
# Extracted from the CLO-derived bp4a-6.6 tree.

config QTI_BATTERY_CHARGER
	tristate "QTI Glink battery charger"
	depends on QTI_PMIC_GLINK
	help
	  Say Y here to enable Qualcomm Technologies, Inc. battery charger
	  driver which interfaces with the charger firmware running on the
	  remote subsystem (e.g. DSP) by communicating over PMIC Glink channel
	  and provides information about the battery, USB and wireless charging
	  by exposing them as power supply devices.

	  To compile the driver as a module, choose M here: the module will be
	  called qti_battery_charger.


config BQ_FUEL_GAUGE
	bool "Xiaomi BQ fuel gauge support in the QTI battery charger"
	depends on QTI_BATTERY_CHARGER
	help
	  Say Y here if the battery is measured by a TI BQ fuel gauge behind
	  the charger firmware, as on Xiaomi garnet. The charger driver then
	  reports the battery capacity and temperature the way the Xiaomi
	  firmware expects and registers a battery thermal zone.


config BQ_FG_UPDATE
	bool "Xiaomi BQ fuel gauge periodic update in the QTI battery charger"
	depends on QTI_BATTERY_CHARGER
	help
	  Say Y here to let the charger driver periodically push the board
	  temperature and screen state to the Xiaomi charger firmware.
```

## drivers/soc/qcom/Kconfig.garnet
```kconfig
# QTI PMIC Glink symbols used by the Xiaomi garnet charger stack.
# Extracted from the CLO-derived bp4a-6.6 tree.

config QTI_PMIC_GLINK
	tristate "Enable support for PMIC GLINK"
	depends on RPMSG
	select QCOM_RPROC_COMMON
	select QCOM_PDR_HELPERS
	help
	  The PMIC Glink driver provides the interface for clients to
	  communicate over GLink for sending and receiving data to charger
	  firmware that runs on a remote subsystem like DSP which supports
	  charging and gauging.
	  This enables clients to read and write battery charging parameters.


config QTI_ALTMODE_GLINK
	tristate "Type-C alternate mode over GLINK"
	depends on QTI_PMIC_GLINK
	help
	  The Qualcomm Technologies, Inc. Type-C alternate mode driver provides
	  an interface for Type-C alternate mode clients to receive data such
	  as Pin Assignment Notifications from the Type-C stack running on a
	  remote subsystem (e.g. DSP) via the PMIC GLINK interface.


config QTI_BATTERY_GLINK_DEBUG
	tristate "Enable support for QTI battery glink debug driver"
	depends on QTI_PMIC_GLINK
	help
	  Qualcomm Technologies, Inc. battery glink debug driver helps to
	  obtain debug information for battery charging and gauging over PMIC
	  Glink from charger and gauging firmware running on a remote subsystem
	  (e.g. DSP).


config QTI_CHARGER_ULOG_GLINK
	tristate "Enable support for QTI charger ulog glink driver"
	depends on QTI_PMIC_GLINK && DEBUG_FS
	help
	  Qualcomm Technologies, Inc. charger ulog glink driver helps to
	  obtain ulogs from battery charging and gauging stack over PMIC
	  Glink from the charger firmware running on a remote subsystem
	  (e.g. DSP).


config QTI_PMIC_GLINK_DEBUG
	tristate "QTI PMIC Glink Debug Device"
	depends on QTI_PMIC_GLINK
	help
	  The Qualcomm Technologies, Inc. PMIC Glink debug device driver
	  provides an interface to read and write PMIC registers over PMIC
	  Glink using a remote subsytem (e.g. DSP).  This allows for debugging
	  PMIC peripherals that would typically only be accessible to the
	  charger and fuel gauging firmware running on the remote subsystem.
	  The PMIC peripherals' bus access can be either SPMI or I2C.

config QCOM_PANEL_EVENT_NOTIFIER
	tristate "panel event notifier"
	depends on DRM
	help
	  Enabling this option adds panel event notifier driver.
	  This driver is responsible for notifying clients interested in display
	  panel events such as panel on, panel off, fps change etc. Clients
	  can use these notifications for power saving or align its operations
	  with display panel power state.
```
